## boards/shields/d3lilahpad/Kconfig.defconfig
```kconfig
# Copyright (c) 2024 D3lilah
# SPDX-License-Identifier: MIT

if SHIELD_D3LILAHPAD

config ZMK_KEYBOARD_NAME
    default "D3lilahPad"

endif
```

## boards/shields/d3lilahpad/Kconfig.shield
```kconfig
# Copyright (c) 2024 D3lilah
# SPDX-License-Identifier: MIT

config SHIELD_D3LILAHPAD
    def_bool $(shields_list_contains,d3lilahpad)
```

## boards/shields/joanpad/Kconfig.defconfig
```kconfig
# Copyright (c) 2024 Joan
# SPDX-License-Identifier: MIT

if SHIELD_JOANPAD

config ZMK_KEYBOARD_NAME
    default "JoanPad"

endif
```

## boards/shields/joanpad/Kconfig.shield
```kconfig
# Copyright (c) 2024 Joan
# SPDX-License-Identifier: MIT

config SHIELD_JOANPAD
    def_bool $(shields_list_contains,joanpad)
```
